## ESP32-firmware/components/cloud_sync/Kconfig.projbuild
```kconfig
menu "Cloud Sync Configuration"

    config CLOUD_SYNC_UPLOAD_INTERVAL_MS
        int "Upload interval in milliseconds"
        default 30000
        help
            Interval between cloud uploads when energy has changed.

    config CLOUD_SYNC_RETRY_DELAY_MS
        int "Retry delay after failed upload in milliseconds"
        default 5000
        help
            Delay before retrying a failed upload.

    config CLOUD_SYNC_TASK_PRIORITY
        int "Cloud sync task priority"
        default 1
        help
            FreeRTOS task priority for the cloud sync task.

    config CLOUD_SYNC_TASK_STACK_SIZE
        int "Cloud sync task stack size in bytes"
        default 8192
        help
            Stack size for the cloud sync task.

    config CLOUD_SYNC_NTP_SERVER_1
        string "Primary NTP server"
        default "pool.ntp.org"
        help
            Primary NTP server for time synchronization.

    config CLOUD_SYNC_NTP_SERVER_2
        string "Secondary NTP server"
        default "time.nist.gov"
        help
            Secondary NTP server for time synchronization.

endmenu
```

## ESP32-firmware/components/gsm_driver/Kconfig.projbuild
```kconfig
menu "GSM Driver Configuration"

    config GSM_PHONE_NUMBER
        string "Phone number for SMS notifications"
        default "+201001234567"
        help
            The phone number (in E.164 format) where the GSM module
            sends boot-time SMS alerts.

    config GSM_FORCE_HTTP
        bool "Force HTTP (disable SSL detection)"
        default n
        help
            Some SIM800 modules falsely report SSL support but fail
            on actual TLS handshakes. Enable this to skip the SSL
            detection and always use plain HTTP.

endmenu
```

## ESP32-firmware/components/http_client/Kconfig.projbuild
```kconfig
menu "HTTP Client Configuration"

    config API_KEY
        string "API Key for backend"
        default "sem-prod-x7k9m2p4q8"

endmenu
```

## ESP32-firmware/components/wifi_sta/Kconfig.projbuild
```kconfig
menu "WiFi Station Configuration"

    config WIFI_SSID
        string "WiFi SSID"
        default "adham"

    config WIFI_PASSWORD
        string "WiFi Password"
        default "adham@9876"

endmenu
```
